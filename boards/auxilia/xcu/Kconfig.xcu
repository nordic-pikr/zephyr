## boards/auxilia/xcu/board.yml
```yaml
board:
  name: xcu
  full_name: Auxilia XCU
  vendor: auxilia
  socs:
    - name: stm32f103xe
```

## boards/auxilia/xcu/dts/bindings/auxilia,xcu-hv-interlock.yaml
```yaml
# SPDX-License-Identifier: Apache-2.0

description: XCU high voltage interlock.

compatible: "auxilia,xcu-hv-interlock"

include: base.yaml

properties:
  close-gpios:
    type: phandle-array
    required: true
    description: HV interlock close output (CLOSE_HV_INTL).

  closed-gpios:
    type: phandle-array
    required: true
    description: HV interlock closed input (HV_INTL_CLOSED).
```

## boards/auxilia/xcu/dts/bindings/auxilia,xcu-lamps.yaml
```yaml
# SPDX-License-Identifier: Apache-2.0

description: |
  XCU warning lamps.

  All lamps are driven together by the common yellow and red outputs.
  Each lamp is described by a child node and reports its state on four
  status inputs: two for the yellow light and two for the red light.

  Example:

    lamps {
      compatible = "auxilia,xcu-lamps";
      yellow-gpios = <&gpioe 5 GPIO_ACTIVE_HIGH>;
      red-gpios = <&gpioe 6 GPIO_ACTIVE_HIGH>;

      lamp1: lamp_1 {
        status-gpios = <&gpioe 0 GPIO_ACTIVE_HIGH>,
                       <&gpioe 1 GPIO_ACTIVE_HIGH>,
                       <&gpioe 2 GPIO_ACTIVE_HIGH>,
                       <&gpioe 3 GPIO_ACTIVE_HIGH>;
      };
    };

compatible: "auxilia,xcu-lamps"

include: base.yaml

properties:
  yellow-gpios:
    type: phandle-array
    required: true
    description: Yellow lamp output (YEL_LAMP), common for all lamps.

  red-gpios:
    type: phandle-array
    required: true
    description: Red lamp output (RED_LAMP), common for all lamps.

  ok-gpios:
    type: phandle-array
    description: Aggregated lamps OK input (LAMPS_OK).

child-binding:
  description: Single warning lamp.

  properties:
    status-gpios:
      type: phandle-array
      required: true
      description: |
        Four lamp status inputs, in order YLAMPn_STATUS1, YLAMPn_STATUS2,
        RLAMPn_STATUS1, RLAMPn_STATUS2.

    label:
      type: string
      description: Human readable lamp name.
```

## boards/auxilia/xcu/dts/bindings/auxilia,xcu-shutter.yaml
```yaml
# SPDX-License-Identifier: Apache-2.0

description: |
  XCU X-ray shutter controlled over discrete GPIO lines.

  The shutter is armed with the enable line and opened by asserting the
  open request line. The shutter reports its position on two open
  acknowledge lines, which have to be evaluated together.

  Example:

    shutter: shutter {
      compatible = "auxilia,xcu-shutter";
      enable-gpios = <&gpiob 12 GPIO_ACTIVE_HIGH>;
      open-rq-gpios = <&gpiod 11 GPIO_ACTIVE_HIGH>;
      open-ack-gpios = <&gpiob 13 GPIO_ACTIVE_HIGH>,
                       <&gpiob 14 GPIO_ACTIVE_HIGH>;
    };

compatible: "auxilia,xcu-shutter"

include: base.yaml

properties:
  enable-gpios:
    type: phandle-array
    required: true
    description: |
      Shutter enable output (ENABLE_SH). The open request must be
      deasserted whenever this line changes state.

  open-rq-gpios:
    type: phandle-array
    required: true
    description: Shutter open request output (SH_OPEN_RQ).

  open-ack-gpios:
    type: phandle-array
    required: true
    description: |
      Two shutter open acknowledge inputs, in order SH_OPEN_ACK1,
      SH_OPEN_ACK2.

  open-gpios:
    type: phandle-array
    description: Shutter open state inputs (SH_OPEN, SH_OPEN_2).

  test-gpios:
    type: phandle-array
    description: Shutter test output (TEST_SHUTTER).

  interlock-closed-gpios:
    type: phandle-array
    description: Shutter interlock closed input (SH_INTL_CLOSED).

  interlock-override-gpios:
    type: phandle-array
    description: Shutter interlock closed override input (SH_INTL_CLOSED_OVERRIDE).

  ok-gpios:
    type: phandle-array
    description: Shutter OK input (SHUTTER_OK).
```
